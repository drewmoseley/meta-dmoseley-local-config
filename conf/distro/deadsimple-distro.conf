## conf/distro/deadsimple-distro.conf
```bitbake
#
# Distro for the dead simple installer
#
require conf/distro/poky.conf

DISTRO = "deadsimple-distro"
DISTRO_NAME = "Dead Simple Installer Distro"
DISTRO_VERSION = "deadsimple-distro-1.0.0"
DISTRO_CODENAME = "deadsimple-distro"

MAINTAINER = "Drew Moseley <drew@moseleynet.net>"

DISTRO_FEATURES = "ipv4 usbhost wifi xattr nfs zeroconf"

SANITY_TESTED_DISTROS = " \
            ubuntu-20.04 \n \
            "

DISABLE_OVERSCAN_rpi = "1"
BOOT_DELAY_rpi = "0"
BOOT_DELAY_MS_rpi = "0"
DISABLE_SPLASH_rpi = "1"
ENABLE_UART_rpi = "1"

DMOSELEY_FEATURES_append = " dmoseley-busybox"
DMOSELEY_FEATURES_remove = " dmoseley-systemd dmoseley-networkd"

VOLATILE_LOG_DIR = "no"

PACKAGE_CLASSES = "package_ipk"

INITRAMFS_IMAGE = "deadsimple-installer-initramfs"
INITRAMFS_IMAGE_BUNDLE = "1"
```

## conf/distro/dmoseley-distro.conf
```bitbake
require conf/distro/poky.conf

DISTRO = "dmoseley-distro"
DISTRO_NAME = "Custom OpenEmbedded Distro for Dmoseley"
YOCTO_VERSION := "${DISTRO_VERSION}"
YOCTO_BRANCH := "${DISTRO_CODENAME}"
DISTRO_VERSION_DMOSELEY = "_dmoseley-distro_${YOCTO_BRANCH}"
DISTRO_VERSION:append = "${DISTRO_VERSION_DMOSELEY}"
DISTRO_CODENAME_DMOSELEY = "_dmoseley-distro"
DISTRO_CODENAME:append = "${DISTRO_CODENAME_DMOSELEY}"
MAINTAINER = "Drew Moseley <drew@moseleynet.net>"
INHERIT += "rm_work"
INHERIT += "dmoseley-setup"
PACKAGE_CLASSES = "package_ipk"
DISTRO_FEATURES:append = " virtualization "
DISTRO_FEATURES:append = " pam "
```

## conf/distro/dmoseley-octoprint.conf
```bitbake
require conf/distro/poky.conf

DISTRO = "dmoseley-octoprint"
DISTRO_NAME = "Custom Octoprint Enabled Distro"
DISTRO_VERSION = "dmoseley-octoprint-1.0.0"
DISTRO_CODENAME = "dmoseley-octoprint-dunfell"

MAINTAINER = "Drew Moseley <drew@moseleynet.net>"

DISTRO_FEATURES:remove = "blueman bluez5 ipv6 bluetooth alsa irda pcmcia 3g avahi"

SANITY_TESTED_DISTROS = " \
            ubuntu-18.04 \n \
            "

DISABLE_OVERSCAN_rpi = "1"
BOOT_DELAY_rpi = "0"
BOOT_DELAY_MS_rpi = "0"
DISABLE_SPLASH_rpi = "1"
CMDLINE:append = " quiet consoleblank=0 loglevel=1 vt.global_cursor_default=0 splash plymouth.ignore-serial-consoles noswap ro fastboot rootwait"
RPI_EXTRA_CONFIG:append:rpi = " \ndtoverlay=gpio-shutdown\n "
SDIMG_ROOTFS_TYPE_rpi = "ext4"
ENABLE_UART_rpi = "1"

NETWORK_MANAGER="networkmanager"
DMOSELEY_FEATURES:append = " dmoseley-networkmanager dmoseley-fastboot dmoseley-homenetworks dmoseley-mender-hosted-server"
DMOSELEY_FEATURES:remove = " dmoseley-networkd dmoseley-labnetworks dmoseley-mender-hosted-server"

VOLATILE_LOG_DIR = "no"

PACKAGE_CLASSES = "package_ipk"

MENDER_FEATURES_ENABLE:append = " mender-growfs-data "
MENDER_ARTIFACT_NAME ??= "octoprint-1.4.2-1.13"
MENDER_UPDATE_POLL_INTERVAL_SECONDS_forcevariable = "900"
MENDER_INVENTORY_POLL_INTERVAL_SECONDS_forcevariable = "900"

SERIAL_CONSOLES=""

PREFERRED_VERSION_python3-tornado = "5.1.1"
PREFERRED_PROVIDER_u-boot-default-env = "libubootenv"
PREFERRED_RPROVIDER_u-boot-default-env = "libubootenv"
```

## conf/distro/dmoseley-shairport-sync.conf
```bitbake
#
# Distro for a minimal Airplay compatible device
#
require conf/distro/poky.conf

DISTRO = "dmoseley-shairport-sync"
DISTRO_NAME = "Shairport Sync Distro"
DISTRO_VERSION = "shairport-sync-1.0.0"
DISTRO_CODENAME = "shairport-sync-dunfell"

MAINTAINER = "Drew Moseley <drew@moseleynet.net>"

DISTRO_FEATURES = "ipv4 usbhost wifi xattr"
MACHINE_FEATURES_remove = "screen touchscreen pci keyboard vfat"

SANITY_TESTED_DISTROS = " \
            ubuntu-20.04 \n \
            "

DISABLE_OVERSCAN_rpi = "1"
BOOT_DELAY_rpi = "0"
BOOT_DELAY_MS_rpi = "0"
DISABLE_SPLASH_rpi = "1"
ENABLE_UART_rpi = "0"

DMOSELEY_FEATURES_remove = " dmoseley-labnetworks"
DMOSELEY_FEATURES_append = " dmoseley-homenetworks dmoseley-readonly "

VOLATILE_LOG_DIR = "yes"

PACKAGE_CLASSES = "package_ipk"

RPI_EXTRA_CONFIG_append = " \ndtparam=audio=on\n "
```

## conf/layer.conf
```bitbake
# We have a conf and classes directory, add to BBPATH
BBPATH .= ":${LAYERDIR}"

# We have recipes-* directories, add to BBFILES
BBFILES += "${LAYERDIR}/recipes-*/*/*.bb \
	${LAYERDIR}/recipes-*/*/*.bbappend"

#
# The dynamic-layers directory hosts layer specific modifications.
#
BBFILES_DYNAMIC += " \
    chromium-browser-layer:${LAYERDIR}/dynamic-layers/chromium-browser-layer/*/*/*.bbappend \
    intel:${LAYERDIR}/dynamic-layers/intel/*/*/*.bb \
    intel:${LAYERDIR}/dynamic-layers/intel/*/*/*.bbappend \
    meta-maker:${LAYERDIR}/dynamic-layers/meta-maker/*/*/*.bb \
    meta-maker:${LAYERDIR}/dynamic-layers/meta-maker/*/*/*.bbappend \
    multimedia-layer:${LAYERDIR}/dynamic-layers/multimedia-layer/*/*/*.bb \
    multimedia-layer:${LAYERDIR}/dynamic-layers/multimedia-layer/*/*/*.bbappend \
    networking-layer:${LAYERDIR}/dynamic-layers/networking-layer/*/*/*.bb \
    networking-layer:${LAYERDIR}/dynamic-layers/networking-layer/*/*/*.bbappend \
    openembedded-layer:${LAYERDIR}/dynamic-layers/openembedded-layer/*/*/*.bb \
    openembedded-layer:${LAYERDIR}/dynamic-layers/openembedded-layer/*/*/*.bbappend \
    qt5-layer:${LAYERDIR}/dynamic-layers/qt5-layer/*/*/*.bb \
    qt5-layer:${LAYERDIR}/dynamic-layers/qt5-layer/*/*/*.bbappend \
    raspberrypi:${LAYERDIR}/dynamic-layers/raspberrypi/*/*/*.bb \
    raspberrypi:${LAYERDIR}/dynamic-layers/raspberrypi/*/*/*.bbappend \
    toradex-nxp-layer:${LAYERDIR}/dynamic-layers/toradex-nxp-layer/*/*/*.bb \
    toradex-nxp-layer:${LAYERDIR}/dynamic-layers/toradex-nxp-layer/*/*/*.bbappend \
    virtualization-layer:${LAYERDIR}/dynamic-layers/virtualization-layer/*/*/*.bbappend \
    meta-ti-bsp:${LAYERDIR}/dynamic-layers/meta-ti-bsp/*/*/*.bbappend \
"

BBFILE_COLLECTIONS += "meta-dmoseley-local-config"
BBFILE_PATTERN_meta-dmoseley-local-config = "^${LAYERDIR}/"
BBFILE_PRIORITY_meta-dmoseley-local-config = "98"

LAYERSERIES_COMPAT_meta-dmoseley-local-config = "scarthgap whinlatter"
LAYERDEPENDS:append:meta-dmoseley-local-config = " openembedded-layer "
```

## meta-dmoseley-mender-raspberrypi/conf/layer.conf
```bitbake
# We have a conf and classes directory, add to BBPATH
BBPATH .= ":${LAYERDIR}"

# We have recipes-* directories, add to BBFILES
BBFILES += "${LAYERDIR}/recipes-*/*/*.bb \
	${LAYERDIR}/recipes-*/*/*.bbappend"

# Let us add layer-specific bbappends which are only applied when that
# layer is included in our configuration
BBFILES += "${@' '.join('${LAYERDIR}/%s/recipes*/*/*.bbappend' % layer \
               for layer in BBFILE_COLLECTIONS.split())}"

BBFILE_COLLECTIONS += "meta-dmoseley-mender-raspberrypi"
BBFILE_PATTERN_meta-dmoseley-mender-raspberrypi = "^${LAYERDIR}/"
BBFILE_PRIORITY_meta-dmoseley-mender-raspberrypi = "15"
```

## meta-dmoseley-mender/conf/layer.conf
```bitbake
# We have a conf and classes directory, add to BBPATH
BBPATH .= ":${LAYERDIR}"

# We have recipes-* directories, add to BBFILES
BBFILES += "${LAYERDIR}/recipes-*/*/*.bb \
	${LAYERDIR}/recipes-*/*/*.bbappend"

# Let us add layer-specific bbappends which are only applied when that
# layer is included in our configuration
BBFILES += "${@' '.join('${LAYERDIR}/%s/recipes*/*/*.bbappend' % layer \
               for layer in BBFILE_COLLECTIONS.split())}"

BBFILE_COLLECTIONS += "meta-dmoseley-mender"
BBFILE_PATTERN_meta-dmoseley-mender = "^${LAYERDIR}/"
BBFILE_PRIORITY_meta-dmoseley-mender = "15"
```

## wic/sdimage-squashfs.wks
```
# short-description: Create read-only Raspberry Pi SD card image
# long-description: Creates a partitioned SD card image for use with
# Raspberry Pi using a readonly squashfs root filesystem.
# . Boot files are located in the first vfat partition.

part /boot --source bootimg-partition --ondisk mmcblk0 --fstype=vfat --label boot --active --align 4096 --size 20
part / --source rootfs --ondisk mmcblk0 --fstype=squashfs --align 4096
```
